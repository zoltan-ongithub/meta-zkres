## conf/bblayers.conf.sample
```bitbake
#
# LAYER_CONF_VERSION is increased each time build/conf/bblayers.conf
# changes incompatibly
LCONF_VERSION = "6"

BBPATH = "${TOPDIR}"
BBFILES ?= ""
CUSTOM_SRC_ROOT := "${@os.path.abspath(os.path.dirname(d.getVar('FILE', True)) + '/../..')}"

BBLAYERS ?= " \
  ${CUSTOM_SRC_ROOT}/meta-zkres \
  ${@'${CUSTOM_SRC_ROOT}/meta-qt5' if os.path.isfile('${CUSTOM_SRC_ROOT}/meta-qt5/conf/layer.conf') else ''} \
  ${CUSTOM_SRC_ROOT}/meta-openembedded/meta-webserver \
  ${CUSTOM_SRC_ROOT}/meta-openembedded/meta-multimedia \
  ${CUSTOM_SRC_ROOT}/meta-openembedded/meta-filesystems \
  ${CUSTOM_SRC_ROOT}/meta-openembedded/meta-oe \
  ${CUSTOM_SRC_ROOT}/meta-openembedded/meta-networking \
  ${CUSTOM_SRC_ROOT}/openembedded/meta \
  "

BBLAYERS += "${@'${CUSTOM_SRC_ROOT}/meta-openembedded/meta-python' if os.path.isfile('${CUSTOM_SRC_ROOT}/meta-openembedded/meta-python/conf/layer.conf') else ''}"
```

## conf/distro/include/modem.inc
```bitbake
DISTRO_FEATURES_append = " cgroup"
LAYERSERIES_COMPAT_zkres += "WTFPL Apache-2.0"
```

## conf/distro/include/versions.conf
```bitbake
ZKRES_RELEASE ?= "0.1"
ZKRES_BRANCH  ?= "master"
ZKRES_GIT ?= "github.com/kuscsik/"
ZKRES_GIT_PROTOCOL ?= "ssh"
```

## conf/distro/zkres.conf
```bitbake
#
# Distribution definition for: zkres
#

DISTRO = "zkres"
DISTRO_NAME = "ZKRES (A Yocto Project based Distro)"
DISTRO_VERSION = "1.0"
DISTRO_CODENAME ?= ""
SDK_VENDOR = "-zkressdk"
SDK_VERSION := "${@'${DISTRO_VERSION}'.replace('snapshot-${DATE}','snapshot')}"
SDK_NAME = "${DISTRO}-${TCLIBC}-${SDK_ARCH}-${TARGET_ARCH}"
SDKPATH = "/opt/${DISTRO}/${SDK_VERSION}"
IMGDEPLOYDIR_dunfell = "${DEPLOY_DIR_IMAGE}"

OVERRIDES .= ":${DISTRO_CODENAME}"

MAINTAINER ?= "Zoltan Kuscsik <zoltan@zkres.com>"

TARGET_VENDOR = "-zkres"

LOCALCONF_VERSION = "1"
LAYER_CONF_VERSION ?= "6"

# Exclude licenses
# INCOMPATIBLE_LICENSE = "GPLv3.0 GPLv3 GPL-3.0 GPLv3+ LGPLv3.0 LGPLv3 LGPL-3.0 LGPLv3+"

# Enable thumb2 by default
ARM_INSTRUCTION_SET_armv7a = "thumb"
ARM_INSTRUCTION_SET_armv7ve = "thumb"


#-----------------------------------------------------------------------------
# Default RDK distro features (which may then be modified by rdkv.inc, etc).
#-----------------------------------------------------------------------------

# Disable this features permanently
DISTRO_FEATURES_BACKFILL_CONSIDERED = "pulseaudio"
DISTRO_FEATURES_BACKFILL_CONSIDERED += "sysvinit"
DISTRO_FEATURES_BACKFILL_CONSIDERED += "ldconfig"

DISTRO_FEATURES = "alsa argp backtrace directfb ext2 ipv4 largefile multiarch nfs opengl pam systemd usbhost wayland xattr zeroconf directfb wayland pam ${DISTRO_FEATURES_LIBC} ${DISTRO_FEATURES_RDK} ${WEBBACKENDS}"

DISTRO_FEATURES_remove_rpi = "directfb"

# Faster linker
DISTRO_FEATURES_append_arm = " ld-is-gold"
DISTRO_FEATURES_append_x86 = " ld-is-gold"
DISTRO_FEATURES_remove_libc-musl = "ld-is-gold"

EXTRA_BLUETOOTH_STUFF := "${@bb.utils.contains('DISTRO_FEATURES', 'bluetooth', bb.utils.contains('DISTRO_FEATURES', 'bluez5', ' bluez5', ' bluez4', d), '', d)}"
DISTRO_FEATURES_append = "${EXTRA_BLUETOOTH_STUFF}"

VIRTUAL-RUNTIME_init_manager ?= "systemd"
VIRTUAL-RUNTIME_initscripts ?= "systemd-compat-units"

IMAGE_FSTYPES = "tar.gz"

# Generate debug rootfs along for debugging purposes
#IMAGE_GEN_DEBUGFS ?= "1"
#IMAGE_FSTYPES_DEBUGFS ?= "tar.gz"

RDEPENDS_${PN}-mtrace_pn-eglibc = ""

# LICENSE_FLAGS_WHITELIST += "somepackage"
LICENSE_FLAGS_WHITELIST +="commercial"

PREFERRED_PROVIDER_directfb ?= "directfb"

# jpeg or jpeg-turbo
PREFERRED_PROVIDER_jpeg = "libjpeg-turbo"
PREFERRED_PROVIDER_jpeg-native = "libjpeg-turbo-native"

# ----------------------------------------------------------------------------

OPTIMIZE_DEFAULT ?= "-O2"
FULL_OPTIMIZATION = "${OPTIMIZE_DEFAULT} -pipe ${DEBUG_FLAGS}"

# ----------------------------------------------------------------------------

TUNE_CCARGS_append = "${@bb.utils.contains('DISTRO_FEATURES', 'backtrace', ' -fno-omit-frame-pointer -fno-optimize-sibling-calls', '',d)}"

#PRSERV_HOST = "localhost:0"

# Splash screen
SPLASH ?= "plymouth"

PREFERRED_PROVIDER_virtual/java-initial ?= "cacao-initial-native"
PREFERRED_PROVIDER_virtual/java-initial-native ?= "cacao-initial-native"
PREFERRED_PROVIDER_virtual/java-native ?= "jamvm-native"
PREFERRED_PROVIDER_virtual/javac-native ?= "ecj-bootstrap-native"
PREFERRED_PROVIDER_virtual/jvm ?= "jvm-noop"

STAGING_KERNEL_BUILDDIR ?= "${STAGING_KERNEL_DIR}"

VOLATILE_BINDS = "/var/volatile/www /www\n"
VOLATILE_BINDS_append = "/var/volatile/resolv.conf /etc/resolv.conf\n"

XZ_COMPRESSION_LEVEL ?= "-e -M 50% -9"
```

## conf/layer.conf
```bitbake
BBPATH .= ":${LAYERDIR}"

BBFILES += "\
            ${LAYERDIR}/recipes-*/*/*.bb \
            ${LAYERDIR}/recipes-*/*/*.bbappend \
           "

BBFILE_COLLECTIONS += "zkres"
BBFILE_PATTERN_zkres:= "^${LAYERDIR}/"
BBFILE_PRIORITY_zkres = "7"

# Additional license directories.
LICENSE_PATH += "${LAYERDIR}/licenses"
```
